## Kconfig
```kconfig
mainmenu "NailGun ISAX integration config"

source "configs/cores_Kconfig"
source "build/ISAX/Kconfig"
source "configs/LN_Kconfig"
source "configs/SCAIE-V_Kconfig"
source "configs/sim_Kconfig"
source "plugins/*/config/Kconfig"
source "configs/advanced_Kconfig"
```

## plugins/openlane/config/Kconfig
```kconfig
config OL2_ENABLE
	bool "Run OpenLane 2"
	default n

menu "OpenLane 2 configuration"
	depends on OL2_ENABLE
	config OL2_DSE
		bool "Run DSE"
		default n
	config OL2_CONFIG_TEMPLATE
		string "config template"
		default "plugins/openlane/config_templates/minimal_config.json"
	config OL2_TARGET_FREQ
		int "MHz = target frequency"
		default 20
	config OL2_TARGET_UTIL
		int "%   = target utilization"
		default 20
	config OL2_ONLY_SYN_ISAX
		depends on !NO_ISAX_ENTRY_POINT
		bool "Only synthesize the ISAX"
		default n
endmenu
```
